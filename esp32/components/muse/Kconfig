## esp32/components/muse/Kconfig
```kconfig
# Copyright (c) Meta Platforms, Inc. and affiliates.
#
# Licensed under the Apache License, Version 2.0 (the "License");
# you may not use this file except in compliance with the License.
# You may obtain a copy of the License at
#
#     http://www.apache.org/licenses/LICENSE-2.0
#
# Unless required by applicable law or agreed to in writing, software
# distributed under the License is distributed on an "AS IS" BASIS,
# WITHOUT WARRANTIES OR CONDITIONS OF ANY KIND, either express or implied.
# See the License for the specific language governing permissions and
# limitations under the License.

menu "Muse"

    choice MUSE_BOARD
        prompt "Board with the full UI"
        default MUSE_BOARD_NONE
        help
            The UI is the voice companion on boards with a screen: an
            animated avatar, push-to-talk chat, settings, and battery
            handling. It runs beside Home Link, which owns Wi-Fi, BLE
            pairing, credentials and OTA. Pick the board it runs on, or none
            for a Link without a display.

        config MUSE_BOARD_NONE
            bool "None (Home Link without a display)"

        config MUSE_BOARD_WAVESHARE_S3_175C
            bool "Waveshare ESP32-S3-Touch-AMOLED-1.75C"
            depends on IDF_TARGET_ESP32S3

        config MUSE_BOARD_WAVESHARE_S3_175
            bool "Waveshare ESP32-S3-Touch-AMOLED-1.75 (not the 1.75C)"
            depends on IDF_TARGET_ESP32S3

        config MUSE_BOARD_AIPI
            bool "AIPI Lite (ESP32-S3, two buttons, no touch)"
            depends on IDF_TARGET_ESP32S3

        config MUSE_BOARD_ESPRESSIF_BOX_3
            bool "Espressif ESP32-S3-BOX-3 (320x240 touch LCD, speaker and microphones)"
            depends on IDF_TARGET_ESP32S3

        config MUSE_BOARD_WAVESHARE_C6_18
            bool "Waveshare ESP32-C6-Touch-AMOLED-1.8"
            depends on IDF_TARGET_ESP32C6

        config MUSE_BOARD_SENSECAP_WATCHER
            bool "Seeed SenseCAP Watcher (ESP32-S3, round touch LCD, wheel)"
            depends on IDF_TARGET_ESP32S3

        config MUSE_BOARD_M5STACK_CARDPUTER_ADV
            bool "M5Stack Cardputer ADV (ESP32-S3, keyboard, no PSRAM)"
            depends on IDF_TARGET_ESP32S3

        config MUSE_BOARD_M5STACK_STICKS3
            bool "M5Stack StickS3 (ESP32-S3, two buttons, no touch)"
            depends on IDF_TARGET_ESP32S3

        config MUSE_BOARD_M5STACK_STICKC_PLUS2
            bool "M5Stack StickC Plus2 (ESP32, two buttons, no touch)"
            depends on IDF_TARGET_ESP32

        config MUSE_BOARD_M5STACK_STOPWATCH
            bool "M5Stack StopWatch (ESP32-S3, round touch AMOLED)"
            depends on IDF_TARGET_ESP32S3
    endchoice

    config MUSE_ENABLED
        bool
        default y if !MUSE_BOARD_NONE

    # Always defined, unlike the target-dependent board options, so
    # idf_component.yml rules can select each board's managed components.
    config MUSE_BOARD_ID
        string
        default "waveshare_s3_175c" if MUSE_BOARD_WAVESHARE_S3_175C
        default "waveshare_s3_175" if MUSE_BOARD_WAVESHARE_S3_175
        default "aipi" if MUSE_BOARD_AIPI
        default "espressif_box_3" if MUSE_BOARD_ESPRESSIF_BOX_3
        default "waveshare_c6_18" if MUSE_BOARD_WAVESHARE_C6_18
        default "sensecap_watcher" if MUSE_BOARD_SENSECAP_WATCHER
        default "m5stack_sticks3" if MUSE_BOARD_M5STACK_STICKS3
        default "m5stack_stickc_plus2" if MUSE_BOARD_M5STACK_STICKC_PLUS2
        default "m5stack_cardputer_adv" if MUSE_BOARD_M5STACK_CARDPUTER_ADV
        default "m5stack_stopwatch" if MUSE_BOARD_M5STACK_STOPWATCH
        default "none"

    # The Muse tools' serial port: the console UART behind the board's USB
    # bridge, where the chip's own USB Serial/JTAG isn't wired to a connector
    # (the Watcher's USB-C goes to a CH342) or the chip has none.
    config MUSE_CONSOLE_UART
        bool
        default y if MUSE_BOARD_SENSECAP_WATCHER || !SOC_USB_SERIAL_JTAG_SUPPORTED

    config MUSE_WATCHER_CAMERA
        bool "SenseCAP Watcher camera capture and live preview"
        depends on MUSE_BOARD_SENSECAP_WATCHER && SPIRAM
        default n
        help
            Enable the camera.capture Home Link command and the wheel
            double-click camera preview. Camera buffers and tasks consume
            memory and preview decoding shares CPU time with voice and Link.
            Leave disabled to build without camera support.

    config MUSE_OPENAI
        bool "Standalone OpenAI voice assistant (no Muse account)"
        depends on SPIRAM && (MUSE_BOARD_WAVESHARE_S3_175C || MUSE_BOARD_WAVESHARE_S3_175)
        select MUSE_HATCH
        select MBEDTLS_HAVE_TIME_DATE
        default n
        help
            Connect directly to api.openai.com using an API key stored in
            NVS. Uses transcription, chat completions and generated speech.
            Wi-Fi and key setup are available on screen or over USB serial.
            Disables Muse pairing, cloud sessions, tunnel and OTA services.
            Audio and transcripts are sent to OpenAI; API usage is billed.
            NVS is not encrypted, so physical access can expose the API key.
            Currently supported on the Waveshare S3 1.75C and 1.75 boards.

    config MUSE_OPENAI_CHAT_MODEL
        string "OpenAI chat model"
        depends on MUSE_OPENAI
        default "gpt-4o-mini"

    config MUSE_WAKEWORD
        bool "Local Hi ESP wake word and hands-free command capture"
        depends on MUSE_OPENAI && IDF_TARGET_ESP32S3
        default n
        help
            Detect Hi ESP locally using ESP-SR WakeNet9, then capture a command
            until speech ends. Requires the wake-word partition table and model
            image. When enabled in Sound settings, the microphone and detector
            remain active on USB and battery, including while the screen is off.
            Idle audio stays local; command audio uses the configured voice API.
            Does not authenticate the speaker. Push-to-talk remains available.

    config MUSE_WAKEWORD_DEFAULT_ENABLED
        bool "Enable hands-free listening by default on first boot"
        depends on MUSE_WAKEWORD
        default n
        help
            A saved Sound setting takes precedence. Leave off unless the user
            explicitly opts into continuous local microphone processing.

    config MUSE_OPENCLAW
        bool "Optional OpenClaw chat backend (OpenAI voice)"
        depends on MUSE_OPENAI
        default n
        help
            Keep the Muse UI and OpenAI transcription/speech, but route chat
            through a private HTTPS bridge to OpenClaw on your computer.
            Configure the bridge URL and its separate token over USB.
            Clearing the URL explicitly returns to direct OpenAI chat.

    config MUSE_OPENCLAW_CA_CERT
        string "Absolute path to the OpenClaw bridge public CA certificate"
        depends on MUSE_OPENCLAW
        default ""
        help
            Embed only the public ca.pem generated by openclaw_bridge.py.
            Never use a private key. Rebuild after changing the trusted CA.

    config MUSE_OPENCLAW_NORMAL_CHROME
        bool "Use the Mac's normal Chrome through its consent-enabled local tools"
        depends on MUSE_OPENCLAW
        default n
        help
            Request the dedicated agent's normal-chrome skill rather than
            the isolated OpenClaw browser profile. Requires Mac setup and
            Chrome 144+ remote-debugging consent. This grants access to
            signed-in sites and all tabs in the connected Chrome profile.

    config MUSE_OPENAI_TRANSCRIPTION_MODEL
        string "OpenAI transcription model"
        depends on MUSE_OPENAI
        default "gpt-4o-mini-transcribe"

    config MUSE_OPENAI_SPEECH_MODEL
        string "OpenAI speech model"
        depends on MUSE_OPENAI
        default "gpt-4o-mini-tts"

    config MUSE_OPENAI_VOICE
        string "OpenAI speech voice"
        depends on MUSE_OPENAI
        default "coral"

    config MUSE_HATCH
        bool "Muse's own voice session"
        depends on MUSE_ENABLED
        default y if SPIRAM
        default n
        help
            Push-to-talk turns go over a voice session of Muse's own, to the
            VM Home Link is paired with or one set up on the device with a
            device token. Replies are text, shown as captions; start_tts in
            muse_chat_session.cpp is where a TTS API of your own can speak
            them. Needs PSRAM. Without it, voice notes go over Home Link's own
            session to its paired VM and replies are shown as text.

endmenu
```
